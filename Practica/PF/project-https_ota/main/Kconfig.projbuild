## Practica/PF/project-https_ota/main/Kconfig.projbuild
```kconfig
menu "HTTPS OTA"

    config EXAMPLE_HTTPS_OTA_TEST
        bool "Enable HTTPS OTA example"
        default n
        help
            Enable this option if you are testing this component individually.
            Disable it if you are integrating it into a larger project.

    config EXAMPLE_FIRMWARE_UPGRADE_URL
        string "firmware upgrade url endpoint"
        default "https://10.71.162.67/project-https_ota_component_test.bin"
        help
            URL of server which hosts the firmware
            image.

    config EXAMPLE_USE_CERT_BUNDLE
        bool "Enable certificate bundle"
        default y
        depends on MBEDTLS_CERTIFICATE_BUNDLE
        help
            Enable trusted root certificate bundle. This approach allows to have
            OTA updates functional with any public server without requirement
            to explicitly add its server certificate.

    config EXAMPLE_SKIP_COMMON_NAME_CHECK
        bool "Skip server certificate CN fieldcheck"
        default n
        help
            This allows you to skip the validation of OTA server certificate CN field.

endmenu
```

## Practica/PF/project-pf_core/components/ICM_42670_P/Kconfig
```kconfig
menu "IMU Configuration"
    
    config MOVEMENT_THRESHOLD
        int "Movement Threshold"
        default 640000000

endmenu
```

## Practica/PF/project-pf_core/components/i2c_bus/Kconfig.projbuild
```kconfig
menu "I2C_BUS Configuration"

    config I2C_SCL_GPIO
        int "PIN SCL" 
        default 8
    
    config I2C_SDA_GPIO
        int "PIN SDA" 
        default 10

endmenu
```

## Practica/PF/project-pf_core/main/Kconfig.projbuild
```kconfig
menu "PF Core Configuration"

    config SAMPLER_PERIOD_MS
        int "Sampler period in ms"
        range 400 3600000
        default 1000
        help
            Define the period in milliseconds between each sample taken by the STHC Monitorization module.
    

    config DEEP_SLEEP_TIME_MS
        int "Deep Sleep time in ms"
        range 1000 3600000
        default 600000
        help
            Define the time in milliseconds that the device will stay in deep sleep mode between each active period.

    config DEBUG_LOG
        bool "Enable debug logs"
        default n
        help
            Enable this option to activate debug logging for the PF Core Module. 
            Show FSM Status transitions and other debugging relevant data.
    
    config RESET_TIMER_ON_UPDATE
        bool "Resets de timer for deep sleep when a new read is taken"
        default n    
    
endmenu
```
