## Practica/P3/src_Ivan/project-sthc3_monitorization/main/Kconfig.projbuild
```kconfig
menu "STHC Monitorization Configuration"

    config SAMPLER_PERIOD_MS
        int "Sampler period in ms"
        range 400 3600000
        default 1000
        help
            Define the period in milliseconds between each sample taken by the STHC Monitorization module.

endmenu
```

## Practica/P4/src_Ivan/project-ICM42670_led/main/Kconfig.projbuild
```kconfig
menu "Example Configuration"

    orsource "$IDF_PATH/examples/common_components/env_caps/$IDF_TARGET/Kconfig.env_caps"

    config I2C_MASTER_SCL
        int "SCL GPIO Num"
        range ENV_GPIO_RANGE_MIN ENV_GPIO_OUT_RANGE_MAX
        default 8
        help
            GPIO number for I2C Master clock line.

    config I2C_MASTER_SDA
        int "SDA GPIO Num"
        range ENV_GPIO_RANGE_MIN ENV_GPIO_OUT_RANGE_MAX
        default 10
        help
            GPIO number for I2C Master data line.

    config I2C_MASTER_FREQUENCY
        int "Master Frequency"
        default 400000
        help
            I2C Speed of Master device.

    config RGB_LED_GPIO
        int "RGB LED GPIO Num"
        range ENV_GPIO_RANGE_MIN ENV_GPIO_OUT_RANGE_MAX
        default 2
        help
            GPIO number for RGB LED control.

    config RGB_LEDS_COUNT
        int "Number of RGB LEDs in the strip"
        range 1 1000
        default 2
        help
            Number of RGB LEDs in the strip.
endmenu
```

## Practica/P5/src_Ivan/project-distance_measurement/main/Kconfig.projbuild
```kconfig
menu "Distance Measurenment Configuration"

    config SAMPLER_PERIOD_MS
        int "Sampler period in ms"
        range 400 3600000
        default 1000
        help
            Define the period in milliseconds between each sample.

    config N
        int "Number of samples to average"
        range 1 100
        default 10
        help
            Define the number of samples to average for each measurement.

    config ADC_UNIT
        int "ADC Unit"
        range 0 1
        default 0
        help
            Define the ADC unit to be used (1 or 2).
    
    config ADC_CHANNEL
        int "ADC Channel"
        range 0 7
        default 6
        help
            Define the ADC channel to be used (0-7).

    config ADC_ATTENUATION
        int "ADC Attenuation"
        range 0 3
        default 3
        help
            Define the ADC attenuation (0-3).
    
    config ADC_BITHWIDTH
        int "ADC Bit Width"
        range 0 12
        default 0
        help
            Define the ADC bit width (0-12).

endmenu
```
